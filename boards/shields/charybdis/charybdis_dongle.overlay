/dts-v1/;

#include "charybdis.dtsi"

/ {

 
    /* redeclare the 5-column transform here */
    five_column_transform: matrix_transform {
        compatible = "zmk,five-column-transform";
        col-offset  = <5>;
    };

    chosen {
        /* point ZMK’s matrix-transform at our newly defined node */
        zmk,matrix-transform = &five_column_transform;
    };

    /* no real keys on a dongle: mock a kscan device */
    mock_kscan: kscan_0 {
        compatible = "zmk,kscan-mock";
        columns    = <0>;
        rows       = <0>;
        events     = <0>;
    };

    chosen {
        zmk,kscan = &mock_kscan;
    };

    /* …and any BLE or display nodes you need… */
};
